## conf/layer.conf
```bitbake
# We have a conf and classes directory, add to BBPATH
BBPATH .= ":${LAYERDIR}"

# We have recipes-* directories, add to BBFILES
BBFILES += "${LAYERDIR}/recipes-*/*/*.bb \
            ${LAYERDIR}/recipes-*/*/*.bbappend"

BBFILE_COLLECTIONS += "meta-babelouest"
BBFILE_PATTERN_meta-babelouest = "^${LAYERDIR}/"
BBFILE_PRIORITY_meta-babelouest = "6"

LAYERDEPENDS_meta-babelouest = "core"
LAYERSERIES_COMPAT_meta-babelouest = "warrior zeus"
```
